## conf/distro/zh-distro.conf
```bitbake
# Inherit from the generic poky/meta-poky/conf/distro/poky.conf distro
require conf/distro/poky.conf

DISTRO="zh-distro" 
DISTRO_NAME="zh-distro"
DISTRO_VERSION?="1.0"

USER_CLASSES ?= "buildstats"
PATCHRESOLVE = "noop"

BB_DISKMON_DIRS ??= "\
    STOPTASKS,${TMPDIR},1G,100K \
    STOPTASKS,${DL_DIR},1G,100K \
    STOPTASKS,${SSTATE_DIR},1G,100K \
    STOPTASKS,/tmp,100M,100K \
    HALT,${TMPDIR},100M,1K \
    HALT,${DL_DIR},100M,1K \
    HALT,${SSTATE_DIR},100M,1K \
    HALT,/tmp,10M,1K"

CONF_VERSION = "2"

DL_DIR ?= "${TOPDIR}/downloads/"
ACCEPT_FSL_EULA = "1"
LICENSE_FLAGS_ACCEPTED = "synaptics-killswitch"

PACKAGE_CLASSES ?= "package_deb"

# Enable systemd and disable sysvinit
DISTRO_FEATURES:append = " systemd usrmerge"
DISTRO_FEATURES_BACKFILL_CONSIDERED:append = " sysvinit"
VIRTUAL-RUNTIME_init_manager = "systemd"
VIRTUAL-RUNTIME_initscripts = ""
VIRTUAL-RUNTIME_dev_manager = "systemd"
```

## conf/machine/zh-rpi4-32b.conf
```bitbake
#base on meta-raspberrypi 4 BSP
require conf/machine/raspberrypi4.conf

MACHINE ??= "raspberrypi4"

# custom settings
ENABLE_UART = "1"
RPI_USE_U_BOOT = "1"

# (optional) extra settings
# KERNEL_IMAGETYPE = "uImage"
```

## conf/machine/zh-rpi4.conf
```bitbake
#base on meta-raspberrypi 4 BSP
require conf/machine/raspberrypi4-64.conf

MACHINE ??= "raspberrypi4-64"

# custom settings
ENABLE_UART = "1"
RPI_USE_U_BOOT = "1"

# (optional) extra settings
# KERNEL_IMAGETYPE = "uImage"
```
